# file: lab02_partA.ioc
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Mcu.Family=STM32G4
Mcu.Name=STM32G491R(C-E)Tx
Mcu.Package=LQFP64
NVIC.PriorityGroup=NVIC_PRIORITYGROUP_4
PA13.GPIO_Label=T_SWDIO
PA13.Signal=SYS_JTMS-SWDIO
PA14.GPIO_Label=T_SWCLK
PA14.Signal=SYS_JTCK-SWCLK
PB3.GPIO_Label=T_SWO
PB3.Signal=SYS_JTDO-SWO
PC14-OSC32_IN.GPIO_Label=RCC_OSC32_IN
PC14-OSC32_IN.Signal=RCC_OSC32_IN
PC15-OSC32_OUT.GPIO_Label=RCC_OSC32_OUT
PC15-OSC32_OUT.Signal=RCC_OSC32_OUT
PF0-OSC_IN.GPIO_Label=RCC_OSC_IN
PF0-OSC_IN.Signal=RCC_OSC_IN
PF1-OSC_OUT.GPIO_Label=RCC_OSC_OUT
PF1-OSC_OUT.Signal=RCC_OSC_OUT
ProjectManager.HeapSize=0x200
ProjectManager.StackSize=0x400
ProjectManager.TargetToolchain=CMake
RCC.ADC12Freq_Value=170000000
RCC.ADC345Freq_Value=170000000
RCC.AHBFreq_Value=170000000
RCC.APB1Freq_Value=170000000
RCC.APB1TimFreq_Value=170000000
RCC.APB2Freq_Value=170000000
RCC.APB2TimFreq_Value=170000000
RCC.CortexFreq_Value=170000000
RCC.EXTERNAL_CLOCK_VALUE=12288000
RCC.HCLKFreq_Value=170000000
RCC.HSE_VALUE=24000000
RCC.HSI48_VALUE=48000000
RCC.HSI_VALUE=16000000
RCC.LSE_VALUE=32768
RCC.PLLM=RCC_PLLM_DIV4
RCC.PLLN=85
RCC.RTCClockSelection=RCC_RTCCLKSOURCE_LSE
RCC.SYSCLKFreq_VALUE=170000000
RCC.SYSCLKSource=RCC_SYSCLKSOURCE_PLLCLK
RCC.USBFreq_Value=48000000
RCC.VCOOutputFreq_Value=340000000
VP_SYS_VS_DBSignals.Mode=DisableDeadBatterySignals
board=NUCLEO-G491RE

// file: Core/Src/main.c
/* USER CODE BEGIN Header */
/**
  ******************************************************************************
  * @file           : main.c
  * @brief          : Main program body
  ******************************************************************************
  * @attention
  *
  * Copyright (c) 2026 STMicroelectronics.
  * All rights reserved.
  *
  * This software is licensed under terms that can be found in the LICENSE file
  * in the root directory of this software component.
  * If no LICENSE file comes with this software, it is provided AS-IS.
  *
  ******************************************************************************
  */
/* USER CODE END Header */
#include "main.h"

/* USER CODE BEGIN PD */
#define LPUART1_BRR_VALUE 377778UL   /* speed: 256 * 170 MHz / 115200 */
#define USART1_BRR_VALUE  1476UL     /* speed: 170 MHz / 115200 */
#define WORK_PASSES       2000000UL
#ifndef A3_ENABLE_DELAY
#define A3_ENABLE_DELAY   1          /* 0: stage (a), 1: stages (b) and (c) */
#endif
#ifndef ECHO_BY_INTERRUPT
#define ECHO_BY_INTERRUPT 0          /* 0: polling, 1: receive interrupt */
#endif
/* USER CODE END PD */

/* USER CODE BEGIN PV */
static uint32_t previous = 0;        /* was B1 down last time? */
/* USER CODE END PV */

void SystemClock_Config(void);
static void MX_GPIO_Init(void);

/* USER CODE BEGIN 0 */
/* RNG: 32-bit random numbers from the true random number generator */
static void rng_init(void)
{
  RCC->CRRCR |= RCC_CRRCR_HSI48ON;             /* start HSI48 */
  while ((RCC->CRRCR & RCC_CRRCR_HSI48RDY) == 0U) { }
  RCC->CCIPR &= ~RCC_CCIPR_CLK48SEL;           /* 00: 48 MHz = HSI48 */
  RCC->AHB2ENR |= RCC_AHB2ENR_RNGEN;           /* RNG clock on */
  RNG->CR |= RNG_CR_RNGEN;                     /* start the RNG */
}

static uint32_t rng_read(void)                  /* wait for a number */
{
  while ((RNG->SR & RNG_SR_DRDY) == 0U) {
    if ((RNG->SR & RNG_SR_SEIS) != 0U) {        /* seed error */
      RNG->SR &= ~RNG_SR_SEIS;                  /* clear SEIS */
      for (uint32_t i = 0; i < 12U; i++) {      /* discard 12 words */
        (void)RNG->DR;
      }
    }
  }
  return RNG->DR;
}

static void uart_init(void)            /* LPUART1: 115200, 8N1 */
{
  RCC->APB1ENR2 |= RCC_APB1ENR2_LPUART1EN;              /* wake up LPUART1 */

  /* PA2, PA3: mode 10 = "do a special job" */
  GPIOA->MODER = (GPIOA->MODER & ~(0xFUL << 4)) | (0xAUL << 4);
  /* the special job is number 12 = LPUART1 (4 bits each pin) */
  GPIOA->AFR[0] = (GPIOA->AFR[0] & ~(0xFFUL << 8)) | (0xCCUL << 8);

  LPUART1->CR1 = 0;                                     /* off, so we may set speed */
  LPUART1->BRR = LPUART1_BRR_VALUE;                     /* set speed */
  LPUART1->CR1 = USART_CR1_TE | USART_CR1_RE | USART_CR1_UE; /* talk, listen, on */

  /* USART1 mirrors the transmitted bytes on PC4 for the oscilloscope. */
  RCC->APB2ENR |= RCC_APB2ENR_USART1EN;
  GPIOC->MODER = (GPIOC->MODER & ~(3UL << 8)) | (2UL << 8);
  GPIOC->AFR[0] = (GPIOC->AFR[0] & ~(0xFUL << 16)) | (7UL << 16);
  USART1->CR1 = 0;
  USART1->BRR = USART1_BRR_VALUE;
  USART1->CR1 = USART_CR1_TE | USART_CR1_UE;
}

static void uart_putc(char character) /* sends one character */
{
  for (;;) {
#if ECHO_BY_INTERRUPT
    /* Keep the readiness check and both writes together if RX interrupts B1. */
    uint32_t primask = __get_PRIMASK();
    __disable_irq();
#endif
    uint32_t ready = ((LPUART1->ISR & USART_ISR_TXE) != 0U) &&
                     ((USART1->ISR & USART_ISR_TXE) != 0U);
    if (ready != 0U) {
      LPUART1->TDR = (uint8_t)character;
      USART1->TDR = (uint8_t)character;
    }
#if ECHO_BY_INTERRUPT
    __set_PRIMASK(primask);
#endif
    if (ready != 0U) {
      return;
    }
  }
}

static void uart_puts(const char *text) /* sends a string */
{
  while (*text != '\0') {
    uart_putc(*text++);                                 /* one letter at a time */
  }
}

#if ECHO_BY_INTERRUPT
void LPUART1_IRQHandler(void)
{
  uint32_t status = LPUART1->ISR;
  if ((status & USART_ISR_ORE) != 0U) {
    LPUART1->ICR = USART_ICR_ORECF;
  }
  if ((status & USART_ISR_RXNE_RXFNE) != 0U) {
    uart_putc((char)LPUART1->RDR);
  }
}
#endif
/* USER CODE END 0 */

int main(void)
{

  /* MCU Configuration--------------------------------------------------------*/

  /* Reset of all peripherals, Initializes the Flash interface and the Systick. */
  HAL_Init();

  /* Configure the system clock */
  SystemClock_Config();

  /* Initialize all configured peripherals */
  MX_GPIO_Init();
  /* USER CODE BEGIN 2 */
  RCC->AHB2ENR |= RCC_AHB2ENR_GPIOAEN | RCC_AHB2ENR_GPIOCEN;   /* wake up port A and C */
  GPIOC->MODER &= ~(3UL << 26);                                /* PC13 (B1): input 00 */
  GPIOA->MODER = (GPIOA->MODER & ~(3UL << 10)) | (1UL << 10);  /* PA5 (LD2): output 01 */
  uart_init();
  rng_init();
  uart_puts("Lab 2 ready.\r\n");                               /* say hello */
#if ECHO_BY_INTERRUPT
  LPUART1->CR1 |= USART_CR1_RXNEIE_RXFNEIE;
  NVIC->ISER[2] = 1UL << 27; /* LPUART1 interrupt 91 = 64 + 27. */
#endif
/* USER CODE END 2 */

  /* Infinite loop */
  /* USER CODE BEGIN WHILE */
  while (1)
  {
    uint32_t now = (GPIOC->IDR >> 13) & 1U;            /* is B1 down now? (1 = down) */
    if (now != 0U && previous == 0U) {                 /* it just went down */
      uart_putc((char)('0' + rng_read() % 10U));       /* send a random digit */
      for (volatile uint32_t i = 0; i < 200000UL; i++) { } /* wait, the button shakes */
    }
    previous = now;                                    /* remember for next time */

#if !ECHO_BY_INTERRUPT
    if ((LPUART1->ISR & USART_ISR_RXNE_RXFNE) != 0U) {
      /* Reading RDR clears RXNE. Keep ORE for the polling demonstration. */
      uart_putc((char)LPUART1->RDR);
    }
#endif

#if A3_ENABLE_DELAY
    GPIOA->ODR ^= GPIO_ODR_OD5;
    for (volatile uint32_t i = 0; i < WORK_PASSES; i++) { }
#endif
    /* USER CODE END WHILE */

  }
}

void SystemClock_Config(void)
{
  RCC_OscInitTypeDef RCC_OscInitStruct = {0};
  RCC_ClkInitTypeDef RCC_ClkInitStruct = {0};

  /** Configure the main internal regulator output voltage
  */
  HAL_PWREx_ControlVoltageScaling(PWR_REGULATOR_VOLTAGE_SCALE1_BOOST);

  /** Initializes the RCC Oscillators according to the specified parameters
  * in the RCC_OscInitTypeDef structure.
  */
  RCC_OscInitStruct.OscillatorType = RCC_OSCILLATORTYPE_HSI;
  RCC_OscInitStruct.HSIState = RCC_HSI_ON;
  RCC_OscInitStruct.HSICalibrationValue = RCC_HSICALIBRATION_DEFAULT;
  RCC_OscInitStruct.PLL.PLLState = RCC_PLL_ON;
  RCC_OscInitStruct.PLL.PLLSource = RCC_PLLSOURCE_HSI;
  RCC_OscInitStruct.PLL.PLLM = RCC_PLLM_DIV4;
  RCC_OscInitStruct.PLL.PLLN = 85;
  RCC_OscInitStruct.PLL.PLLP = RCC_PLLP_DIV2;
  RCC_OscInitStruct.PLL.PLLQ = RCC_PLLQ_DIV2;
  RCC_OscInitStruct.PLL.PLLR = RCC_PLLR_DIV2;
  if (HAL_RCC_OscConfig(&RCC_OscInitStruct) != HAL_OK)
  {
    Error_Handler();
  }

  /** Initializes the CPU, AHB and APB buses clocks
  */
  RCC_ClkInitStruct.ClockType = RCC_CLOCKTYPE_HCLK|RCC_CLOCKTYPE_SYSCLK
                              |RCC_CLOCKTYPE_PCLK1|RCC_CLOCKTYPE_PCLK2;
  RCC_ClkInitStruct.SYSCLKSource = RCC_SYSCLKSOURCE_PLLCLK;
  RCC_ClkInitStruct.AHBCLKDivider = RCC_SYSCLK_DIV1;
  RCC_ClkInitStruct.APB1CLKDivider = RCC_HCLK_DIV1;
  RCC_ClkInitStruct.APB2CLKDivider = RCC_HCLK_DIV1;

  if (HAL_RCC_ClockConfig(&RCC_ClkInitStruct, FLASH_LATENCY_4) != HAL_OK)
  {
    Error_Handler();
  }
}

static void MX_GPIO_Init(void)
{

  /* GPIO Ports Clock Enable */
  __HAL_RCC_GPIOC_CLK_ENABLE();
  __HAL_RCC_GPIOF_CLK_ENABLE();
  __HAL_RCC_GPIOA_CLK_ENABLE();
  __HAL_RCC_GPIOB_CLK_ENABLE();

}

void Error_Handler(void)
{
  __disable_irq();
  while (1)
  {
  }
}
